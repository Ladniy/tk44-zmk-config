## config/boards/arm/tk44/Kconfig.defconfig
```kconfig
# Copyright (c) 2022 The ZMK Contributors
# SPDX-License-Identifier: MIT

if BOARD_TK44

config ZMK_KEYBOARD_NAME
	default "TK44"

if USB_DEVICE_STACK

config USB_NRFX
	default y

endif # USB_DEVICE_STACK

config BOARD
	default "tk44"

config BT_CTLR
	default BT

endif # BOARD_TK44
```
